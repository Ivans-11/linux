## drivers/virt/axvisor/Kconfig
```kconfig
config AXVISOR_LINUX_BRIDGE
	tristate "AxVisor Linux host bridge"
	default n
	help
	  Build the Linux host provider and link the no_std AxVisor Rust domain.
	  Select M to build the provider as axvisor_linux.ko.

config AXVISOR_LINUX_CONTROL
	bool "AxVisor Linux control endpoint"
	depends on AXVISOR_LINUX_BRIDGE != n
	select MISC_DEVICES
	default n
	help
	  Publish AxVisor's KVM-compatible control endpoint as /dev/kvm.

config AXVISOR_LINUX_CONFORMANCE
	bool "AxVisor host-contract conformance runner"
	depends on AXVISOR_LINUX_BRIDGE != n
	default n
	help
	  Build the host-only runner for the shared AxVisor contract tests.
```
